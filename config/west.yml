## config/west.yml
```yaml
# Usage: cd repo && west init -l config
manifest:
  self:
    import: west-isolated.yml
```

## dts/bindings/input_processors/zmk,input-processor-accel.yaml
```yaml
# SPDX-License-Identifier: GPL-2.0-or-later
description: |
  Trackball cursor acceleration input processor. Scales REL_X/REL_Y movement by a
  factor that ramps from min-factor to max-factor (both expressed as a percentage,
  same convention as zmk,input-processor-scaler's mult/div) as the instantaneous
  speed goes from speed-threshold to speed-max counts/sec, following an integer
  power curve (accel-exponent). All math is fixed-point (no floating point).
  Implemented in src/trackball_accel.c.

compatible: "zmk,input-processor-accel"

include: ip_two_param.yaml
# input-processor-cells: min-factor (percent), max-factor (percent)
#   e.g. <&zip_xy_accel 65 100>  => 65% at/below speed-threshold, ramping up to
#   100% at/above speed-max.

properties:
  speed-threshold:
    type: int
    default: 600
    description: |
      Speed (raw counts/sec) at or below which min-factor is applied unchanged.
  speed-max:
    type: int
    default: 3000
    description: |
      Speed (raw counts/sec) at or above which max-factor is applied (ceiling).
  accel-exponent:
    type: int
    default: 2
    description: |
      Integer power (1-4) of the ease-in curve between speed-threshold and
      speed-max. 1 = linear ramp, 2 = quadratic (default), higher = more
      "sluggish start, sharp ramp near speed-max".
  min-dt-ms:
    type: int
    default: 4
    description: |
      Floor clamp on the inter-sample time used for the speed calculation, to
      avoid divide-by-near-zero speed spikes from back-to-back events.
  max-dt-ms:
    type: int
    default: 100
    description: |
      Ceiling clamp on the inter-sample time; gaps larger than this are treated
      as the start of a fresh motion (speed resets toward min-factor) rather
      than an artificially tiny computed speed.
```

## dts/bindings/input_processors/zmk,input-processor-gesture.yaml
```yaml
description: |
  Trackball direction-gesture input processor. Detects up/down/left/right swipes
  while a gesture layer is active and suppresses the pointer during gestures.
  Implemented in src/trackball_gesture.c. Takes no parameters.

compatible: "zmk,input-processor-gesture"

include: ip_zero_param.yaml
```

## dts/bindings/input_processors/zmk,input-processor-scroll-inertia.yaml
```yaml
# SPDX-License-Identifier: GPL-2.0-or-later
description: |
  Trackball scroll inertia input processor. It observes post-scaled and snapped
  REL_HWHEEL/REL_WHEEL samples and emits decaying scroll events from a virtual
  input device after a sufficiently fast flick ends.

  The two input-processor cells normalize the preceding scaler back to a common
  speed domain: normalization multiplier followed by normalization divisor.
  For example, use <&zip_scroll_inertia 100 2> after a 2/100 scaler and
  <&zip_scroll_inertia 100 40> after a 40/100 scaler.

compatible: "zmk,input-processor-scroll-inertia"

include: ip_two_param.yaml

properties:
  start-speed:
    type: int
    default: 10
    description: Minimum normalized speed in counts per second required to arm inertia.

  stop-speed:
    type: int
    default: 1
    description: Stop inertia below this normalized speed in counts per second.

  max-speed:
    type: int
    default: 1000
    description: Maximum normalized speed captured for inertia.

  tail-speed:
    type: int
    default: 100
    description: Normalized speed below which to enter the soft stopping phase.

  friction-permille:
    type: int
    default: 950
    description: Velocity retained after each tick, where 1000 means no friction.

  tail-friction-permille:
    type: int
    default: 985
    description: Velocity and residual retained near stop-speed; interpolated from friction-permille across the soft stopping phase.

  tick-ms:
    type: int
    default: 8
    description: Interval in milliseconds between synthetic scroll reports.

  start-delay-ms:
    type: int
    default: 12
    description: Quiet period after the last real sample before inertia starts.

  min-dt-ms:
    type: int
    default: 4
    description: Minimum interval used for speed calculation when samples share a millisecond.

  sample-timeout-ms:
    type: int
    default: 50
    description: Gap after which a sample is treated as a fresh movement with no usable velocity.

  reverse-cancel-threshold:
    type: int
    default: 1
    description: Minimum opposite scroll count that immediately cancels pending inertia.
```
